## Config.in
```kconfig
source "$BR2_EXTERNAL_CONAN_PATH/package/conan-examples-md5/Config.in"
source "$BR2_EXTERNAL_CONAN_PATH/package/conan-examples-folly/Config.in"
```

## package/conan-examples-folly/Config.in
```kconfig
config BR2_PACKAGE_CONAN_EXAMPLES_FOLLY
	bool "conano.io folly example"
	help
	  Folly conan package example

	  git@github.com:conan-io/examples.git
```

## package/conan-examples-md5/Config.in
```kconfig
config BR2_PACKAGE_CONAN_EXAMPLES_MD5
	bool "conano.io MD5 example"
	help
	  MD5 conan package example

	  git@github.com:conan-io/examples.git
```
